## config/boards/shields/custom_split/Kconfig.defconfig
```kconfig
if SHIELD_CUSTOM_SPLIT_LEFT

config ZMK_KEYBOARD_NAME
    default "Custom Split"

config ZMK_SPLIT_ROLE_CENTRAL
    default y

endif

if SHIELD_CUSTOM_SPLIT_LEFT || SHIELD_CUSTOM_SPLIT_RIGHT

config ZMK_SPLIT
    default y

endif
```

## config/boards/shields/custom_split/Kconfig.shield
```kconfig
config SHIELD_CUSTOM_SPLIT_LEFT
    def_bool $(shields_list_contains,custom_split_left)

config SHIELD_CUSTOM_SPLIT_RIGHT
    def_bool $(shields_list_contains,custom_split_right)
```
